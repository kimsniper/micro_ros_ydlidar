## main/Kconfig.projbuild
```kconfig
menu "Micro-ROS YDLidar Setting"

    config LIDAR_UART_PORT
        int "UART Port Number"
        range 0 2
        default 1
        help
            The hardware UART peripheral port number to utilize for the laser scanner communication stream.

    config LIDAR_TX_GPIO
        int "UART TX GPIO Num"
        default 21 if IDF_TARGET_ESP32C3
        default 22 if IDF_TARGET_ESP32 || IDF_TARGET_ESP32S2 || IDF_TARGET_ESP32S3
        help
            GPIO number for the ESP32 UART Transmitter pin (Connects to Lidar RX).

    config LIDAR_RX_GPIO
        int "UART RX GPIO Num"
        default 20 if IDF_TARGET_ESP32C3
        default 21 if IDF_TARGET_ESP32 || IDF_TARGET_ESP32S2 || IDF_TARGET_ESP32S3
        help
            GPIO number for the ESP32 UART Receiver pin (Connects to Lidar TX).

    config LIDAR_BAUDRATE
        int "Lidar Baud Rate"
        default 128000
        help
            Serial communication speed required by your specific YDLidar model (e.g., 128000, 115200, 234000).

    config MICRO_ROS_APP_STACK
        int "Stack the micro-ROS app (Bytes)"
        default 20000
        help
            Stack size in Bytes allocated for the micro-ROS app task loop to handle large LaserScan arrays.

    config MICRO_ROS_APP_TASK_PRIO
        int "Priority of the micro-ROS app"
        default 5
        help
            Priority of micro-ros task. A higher numerical value signifies an elevated priority scheduling window.

endmenu
```
